/dts-v1/;

/ {
	model = "Qualcomm Technologies, Inc. Holi RUMI";
	compatible = "qcom,holi-rumi\0qcom,holi\0qcom,rumi";
	qcom,msm-id = <0x1c6 0x10000>;
	qcom,board-id = <0x0f 0x00>;

	fragment@0 {
		target = <0xffffffff>;

		__overlay__ {

			timer {
				clock-frequency = <0x7a120>;
			};

			timer@f420000 {
				clock-frequency = <0x7a120>;
			};

			wdog {
				status = "disabled";
			};

			usb_emu_phy@0x04f20000 {
				compatible = "qcom,usb-emu-phy";
				reg = <0x4f20000 0x9500>;
				qcom,emu-init-seq = <0xffff 0x04 0xfff0 0x04 0x100000 0x20 0x00 0x20 0x101f0 0x20 0x100000 0x3c 0x00 0x3c 0x10060 0x3c 0x00 0x04>;
				phandle = <0x01>;
			};
		};
	};

	fragment@1 {
		target = <0xffffffff>;

		__overlay__ {
			status = "disabled";
		};
	};

	fragment@2 {
		target = <0xffffffff>;

		__overlay__ {
			status = "disabled";
		};
	};

	fragment@3 {
		target = <0xffffffff>;

		__overlay__ {
			dpdm-supply = <0xffffffff>;

			dwc3@4e00000 {
				usb-phy = <0x01 0xffffffff>;
				maximum-speed = "high-speed";
				dr_mode = "peripheral";
			};
		};
	};

	fragment@4 {
		target = <0xffffffff>;

		__overlay__ {
			status = "disabled";
			pinctrl-names = "default\0sleep";
			pinctrl-0 = <0xffffffff>;
			pinctrl-1 = <0xffffffff>;
			cap-mmc-highspeed;
			vdd-supply = <0xffffffff>;
			qcom,vdd-voltage-level = <0x2d2a80 0x2d2a80>;
			qcom,vdd-current-level = <0x00 0x8b290>;
			vdd-io-supply = <0xffffffff>;
			qcom,vdd-io-always-on;
			qcom,vdd-io-lpm-sup;
			qcom,vdd-io-voltage-level = <0x1b7740 0x1b7740>;
			qcom,vdd-io-current-level = <0x00 0x4f588>;
		};
	};

	fragment@5 {
		target = <0xffffffff>;

		__overlay__ {
			status = "ok";
			pinctrl-names = "default\0sleep";
			pinctrl-0 = <0xffffffff>;
			pinctrl-1 = <0xffffffff>;
			cap-sd-highspeed;
			vdd-supply = <0xffffffff>;
			qcom,vdd-voltage-level = <0x2d2a80 0x2d2a80>;
			qcom,vdd-current-level = <0x00 0xc3500>;
			vdd-io-supply = <0xffffffff>;
			qcom,vdd-io-voltage-level = <0x2d2a80 0x2d2a80>;
			qcom,vdd-io-current-level = <0x00 0x55f0>;
			cd-gpios = <0xffffffff 0x5e 0x01>;
		};
	};

	fragment@6 {
		target = <0xffffffff>;

		__overlay__ {
			compatible = "qcom,ufs-phy-qrbtc-sdm845";
			vdda-phy-supply = <0xffffffff>;
			vdda-pll-supply = <0xffffffff>;
			vdda-phy-max-microamp = <0xf5b4>;
			vdda-pll-max-microamp = <0x477c>;
			status = "ok";
		};
	};

	fragment@7 {
		target = <0xffffffff>;

		__overlay__ {
			limit-tx-hs-gear = <0x01>;
			limit-rx-hs-gear = <0x01>;
			limit-rate = <0x01>;
			vdd-hba-supply = <0xffffffff>;
			vdd-hba-fixed-regulator;
			vcc-supply = <0xffffffff>;
			vcc-max-microamp = "\0\f5";
			vccq2-supply = <0xffffffff>;
			vccq2-max-microamp = "\0\f5";
			qcom,vddp-ref-clk-supply = <0xffffffff>;
			qcom,vddp-ref-clk-max-microamp = <0x64>;
			qcom,disable-lpm;
			rpm-level = <0x00>;
			spm-level = <0x00>;
			status = "ok";
		};
	};

	fragment@8 {
		target = <0xffffffff>;

		__overlay__ {
			qcom,rumi_platform;
		};
	};

	fragment@9 {
		target = <0xffffffff>;

		__overlay__ {
			status = "disabled";
		};
	};

	__symbols__ {
		usb_emu_phy_0 = "/fragment@0/__overlay__/usb_emu_phy@0x04f20000";
	};

	__fixups__ {
		soc = "/fragment@0:target:0";
		tsens0 = "/fragment@1:target:0";
		tsens1 = "/fragment@2:target:0";
		usb0 = "/fragment@3:target:0";
		usb_nop_phy = "/fragment@3/__overlay__:dpdm-supply:0\0/fragment@3/__overlay__/dwc3@4e00000:usb-phy:4";
		sdhc_1 = "/fragment@4:target:0";
		sdc1_on = "/fragment@4/__overlay__:pinctrl-0:0";
		sdc1_off = "/fragment@4/__overlay__:pinctrl-1:0";
		L7E = "/fragment@4/__overlay__:vdd-supply:0\0/fragment@7/__overlay__:vcc-supply:0";
		L12A = "/fragment@4/__overlay__:vdd-io-supply:0\0/fragment@7/__overlay__:vccq2-supply:0";
		sdhc_2 = "/fragment@5:target:0";
		sdc2_on = "/fragment@5/__overlay__:pinctrl-0:0";
		sdc2_off = "/fragment@5/__overlay__:pinctrl-1:0";
		L9E = "/fragment@5/__overlay__:vdd-supply:0";
		L6E = "/fragment@5/__overlay__:vdd-io-supply:0";
		tlmm = "/fragment@5/__overlay__:cd-gpios:0";
		ufsphy_mem = "/fragment@6:target:0";
		L18A = "/fragment@6/__overlay__:vdda-phy-supply:0";
		L22A = "/fragment@6/__overlay__:vdda-pll-supply:0\0/fragment@7/__overlay__:qcom,vddp-ref-clk-supply:0";
		ufshc_mem = "/fragment@7:target:0";
		gcc_ufs_phy_gdsc = "/fragment@7/__overlay__:vdd-hba-supply:0";
		qupv3_se9_2uart = "/fragment@8:target:0";
		qupv3_se10_i2c = "/fragment@9:target:0";
	};

	__local_fixups__ {

		fragment@3 {

			__overlay__ {

				dwc3@4e00000 {
					usb-phy = <0x00>;
				};
			};
		};
	};
};
